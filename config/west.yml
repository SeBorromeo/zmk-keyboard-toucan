## config/west.yml
```yaml
manifest:
  defaults:
    revision: v0.3

  remotes:
    - name: zmkfirmware
      url-base: https://github.com/zmkfirmware
    - name: urob
      url-base: https://github.com/urob
    - name: caksoylar
      url-base: https://github.com/caksoylar
    - name: geeksville
      url-base: https://github.com/geeksville
      
  projects:
    - name: zmk
      remote: zmkfirmware
      import: app/west.yml

      # ZMK modules
    - name: zmk-adaptive-key
      remote: urob
      path: modules/zmk/adaptive-key
    - name: zmk-auto-layer
      remote: urob
      path: modules/zmk/auto-layer
    - name: zmk-helpers
      remote: urob
      path: modules/zmk/helpers
    - name: zmk-leader-key
      remote: urob
      path: modules/zmk/leader-key
    - name: zmk-tri-state
      remote: urob
      path: modules/zmk/tri-state
      
    - name: cirque-input-module
      remote: geeksville
      revision: toucan
    - name: zmk-rgbled-widget
      remote: caksoylar
      revision: v0.3
      
  self:
    path: config
```
